## drivers/net/ethernet/cavium/Kconfig
```kconfig
#
# Cavium ethernet device configuration
#

config NET_VENDOR_CAVIUM
        tristate "Cavium ethernet drivers"
	depends on PCI
        ---help---
          If you have Cavium Thunder board, say Y.

if NET_VENDOR_CAVIUM

config THUNDER_NIC_PF
        tristate "Thunder Physical function driver"
	default NET_VENDOR_CAVIUM
	select THUNDER_NIC_BGX
        ---help---
          This driver supports Thunder's NIC physical function.

config THUNDER_NIC_VF
        tristate "Thunder Virtual function driver"
	default NET_VENDOR_CAVIUM
        ---help---
          This driver supports Thunder's NIC virtual function

config	THUNDER_NIC_BGX
        tristate "Thunder MAC interface driver(BGX)"
	default NET_VENDOR_CAVIUM
        ---help---
          This driver supports programming and controlling of MAC
	  interface from NIC physical function driver.

endif # NET_VENDOR_CAVIUM
```

## drivers/soc/thunderx/Kconfig
```kconfig
#
# Cavium thunderx SoC drivers
#
config THUNDERX_GTI
	bool "Thunderx SoC GTI driver to sync timers across nodes"
	depends on  ARCH_THUNDER && NUMA
	help
		Thunderx SoC GTI driver to sync timers across nodes

config THUNDERX_GTI_SYNC_PERIOD
	int "Sync period in minutes"
	range 5 120
	depends on THUNDERX_GTI
	default "5"
	help
		Sync Period in minutes.
```
